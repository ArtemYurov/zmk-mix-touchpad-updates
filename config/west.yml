## config/west.yml
```yaml
manifest:
  remotes:
  - name: zmkfirmware
    url-base: https://github.com/zmkfirmware

  projects:
  - name: zmk
    url: https://github.com/ArtemYurov/zmk
    revision: mix/state-sync
    import: app/west.yml
  - name: nice-view-central-relay
    url: https://github.com/ArtemYurov/nice-view-central-relay
    revision: feature/zmk-state-sync
  - name: zmk-cirque-input-rotate
    url: https://github.com/ArtemYurov/zmk-cirque-input-rotate
    revision: main
  self:
    path: config
```
