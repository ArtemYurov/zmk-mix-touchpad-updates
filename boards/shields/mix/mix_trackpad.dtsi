/*
 * Cirque trackpad input listener configuration for Mix keyboard.
 * Included by mix_right.overlay (central half with Cirque trackpad).
 */

#include <input/processors.dtsi>
#include <dt-bindings/zmk/input_transform.h>

/ {
    // zmk-cirque-input-rotate: while rotation is on, only the listener below may read &glidepoint
    glidepoint_rotate: glidepoint_rotate {
        compatible = "zmk,cirque-input-rotate";
        input = <&glidepoint>;
        angle = <(MIX_TRACKPAD_ROTATION)>;
#if MIX_TRACKPAD_ROTATION != 0
        status = "okay";
#else
        status = "disabled";
#endif
    };

    glidepoint_listener: glidepoint_listener {
        compatible = "zmk,input-listener";
#if MIX_TRACKPAD_ROTATION != 0
        device = <&glidepoint_rotate>;
#else
        device = <&glidepoint>;
#endif
        status = "okay";
        input-processors =
            <&zip_xy_transform (INPUT_TRANSFORM_Y_INVERT)>,
            <&zip_xy_scaler MIX_MOUSE_SPEED_NUM MIX_MOUSE_SPEED_DEN>,
            <&zip_scroll_transform (MIX_EDGE_SCROLL_TRANSFORM)>,
            <&zip_scroll_scaler MIX_EDGE_SCROLL_SPEED_NUM MIX_EDGE_SCROLL_SPEED_DEN>;

        // Base processors are skipped while a scroll layer is active, so edge scroll is handled
        // here again, and motion is scaled before the scroll mapping to leave edge scroll intact
        scroller {
            layers = <MIX_SCROLL_LAYERS>;
            input-processors =
                <&zip_scroll_transform (MIX_EDGE_SCROLL_TRANSFORM)>,
                <&zip_scroll_scaler MIX_EDGE_SCROLL_SPEED_NUM MIX_EDGE_SCROLL_SPEED_DEN>,
                <&zip_xy_transform (INPUT_TRANSFORM_X_INVERT)>,
                <&zip_xy_scaler MIX_SCROLL_SPEED_NUM MIX_SCROLL_SPEED_DEN>,
                <&zip_xy_to_scroll_mapper>;
        };
    };
};
